## boards/xtensa/esp32c/Kconfig.board
```kconfig
# ESP32c board configuration

# Copyright (c) 2020 Espressif Corporation
# SPDX-License-Identifier: Apache-2.0

config BOARD_ESP32C
	bool "ESP32C Development Board"
	depends on SOC_ESP32C
```

## boards/xtensa/esp32c/Kconfig.defconfig
```kconfig
# ESP32C board configuration

# Copyright (c) 2020 Espressif Corporation
# SPDX-License-Identifier: Apache-2.0
if BOARD_ESP32C
config BOARD
	default "esp32c"
	depends on BOARD_ESP32C

config ENTROPY_ESP32C_RNG
	default y if ENTROPY_GENERATOR
endif
```

## boards/xtensa/esp32c/esp32c_defconfig
```kconfig
# SPDX-License-Identifier: Apache-2.0

CONFIG_XTENSA_RESET_VECTOR=n

CONFIG_BOARD_ESP32C=y
CONFIG_SOC_ESP32C=y

CONFIG_MAIN_STACK_SIZE=2048

CONFIG_SYS_CLOCK_HW_CYCLES_PER_SEC=80000000

CONFIG_CONSOLE=y
CONFIG_SERIAL=y
CONFIG_UART_CONSOLE=y
CONFIG_UART_ESP32C=y

CONFIG_XTENSA_USE_CORE_CRT1=n

CONFIG_PINMUX=y
CONFIG_PINMUX_ESP32C=y

CONFIG_GPIO=y
CONFIG_GPIO_ESP32C=y

CONFIG_GEN_ISR_TABLES=y
CONFIG_GEN_IRQ_VECTOR_TABLE=n

CONFIG_I2C=n
CONFIG_I2C_ESP32C=n
CONFIG_I2C_0=n
CONFIG_I2C_1=n
CONFIG_I2C_2=n
CONFIG_I2C_3=n

CONFIG_LOG_MINIMAL=y
CONFIG_ESP32_BLUETOOTH_USED=y
CONFIG_BT_UART_ON_DEV_NAME="UART_1"
```

## drivers/bluetooth/Kconfig
```kconfig
# Bluetooth LE driver configuration options

# Copyright (c) 2015-2016 Intel Corporation
# SPDX-License-Identifier: Apache-2.0

#
# Bluetooth options
#

# Controller support is an HCI driver in itself, so these HCI driver
# options are only applicable if controller support hasn't been enabled.
menu "Bluetooth Drivers"
	depends on BT && !BT_CTLR
	
if BT_HCI
source "drivers/bluetooth/hci/Kconfig"
endif

if ESP32_VHCI
source "subsys/bluetooth/esp_bluetooth/hci/Kconfig"
endif

if BT_CUSTOM
# Insert here any custom (non-HCI) offload drives
endif
config ESP32_BLUETOOTH_USED
	bool "Use esp32 to run zephyr host"
	help
	  This option allows to run zephyr host on ESP32.
endmenu
```

## drivers/entropy/Kconfig.esp32c
```kconfig
# esp32 entropy generator driver configuration

# Copyright (c) 2017 Intel Corporation
# SPDX-License-Identifier: Apache-2.0

config ENTROPY_ESP32C_RNG
	bool "ESP32C entropy number generator driver"
	depends on SOC_ESP32C
	select ENTROPY_HAS_DRIVER
	help
	  This option enables the entropy number generator for ESP32C SoCs.

	  With Wi-Fi and Bluetooth disabled, this will produce pseudo-entropy
	  numbers: noise from these radios are used to feed entropy in this
	  generator.
```

## drivers/gpio/Kconfig.esp32c
```kconfig
# ESP32C GPIO configuration options

# Copyright (c) 2017 Intel Corporation
# SPDX-License-Identifier: Apache-2.0

menuconfig GPIO_ESP32C
	bool "ESP32C GPIO"
	depends on SOC_ESP32C
	help
	  Enables the ESP32C GPIO driver

if GPIO_ESP32C

config GPIO_ESP32C_IRQ
	int "IRQ line for ESP32C GPIO pins"
	default 10
	help
	  Select the IRQ line to be used for GPIO interrupts.

	  Edge-triggered interrupts are supported on lines: 10, 22,
	  28, 30.

	  Level-triggered interrupts are supported on lines: 0-5, 8,
	  9, 12, 13, 17-21, 23-27, 31.

config GPIO_ESP32C_0
	bool "ESP32C GPIO (pins 0-31)"
	default y
	help
	  Include support for GPIO pins 0-31 on the ESP32C.

config GPIO_ESP32C_1
	bool "ESP32C GPIO (pins 32-39)"
	default y
	help
	  Include support for GPIO pins 32-39 on the ESP32C.

endif # GPIO_ESP32C
```

## drivers/i2c/Kconfig.esp32c
```kconfig
# ESP32 I2C configuration options

# Copyright (c) 2017 Intel Corporation
# SPDX-License-Identifier: Apache-2.0

menuconfig I2C_ESP32C
	bool "ESP32C I2C"
	depends on SOC_ESP32C
	select GPIO_ESP32C
	help
	  Enables the ESP32C I2C driver

if I2C_ESP32C

config I2C_ESP32C_TIMEOUT
	int "I2C timeout to receive a data bit in APB clock cycles"
	default 200000

if I2C_0

config I2C_ESP32C_0_TX_LSB_FIRST
	bool "Port 0 Transmit LSB first"

config I2C_ESP32C_0_RX_LSB_FIRST
	bool "Port 0 Receive LSB first"

config I2C_ESP32C_0_IRQ
	int "Port 0 IRQ line"
	default 8

endif # I2C_0

if I2C_1

config I2C_ESP32C_1_TX_LSB_FIRST
	bool "Port 1 Transmit LSB first"

config I2C_ESP32C_1_RX_LSB_FIRST
	bool "Port 1 Receive LSB first"

config I2C_ESP32C_1_IRQ
	int "Port 1 IRQ line"
	default 9

endif # I2C_1

endif # I2C_ESP32C
```

## drivers/pinmux/Kconfig.esp32c
```kconfig
# ESP32 Pin mux configuration options

# Copyright (c) 2017 Intel Corporation
# SPDX-License-Identifier: Apache-2.0

config PINMUX_ESP32C
	bool "ESP32C Pin multiplexer driver"
	depends on SOC_ESP32C
	help
	  Enable driver for ESP32C Pin multiplexer.
```

## drivers/serial/Kconfig.esp32c
```kconfig
# SPDX-License-Identifier: Apache-2.0

config UART_ESP32C
	bool "ESP32C UART driver"
	default y
	select SERIAL_HAS_DRIVER
	select SERIAL_SUPPORT_INTERRUPT
	select GPIO_ESP32C
	depends on SOC_ESP32C
	help
	  Enable the ESP32C UART using ROM routines.
```

## dts/bindings/gpio/espressif,esp32c-gpio.yaml
```yaml
# Copyright (c) 2019, Yannis Damigos
# SPDX-License-Identifier: Apache-2.0

description: ESP32C GPIO controller

compatible: "espressif,esp32c-gpio"

include: [gpio-controller.yaml, base.yaml]

properties:
    reg:
        required: true

    label:
        required: true

    "#gpio-cells":
        const: 2

gpio-cells:
  - pin
  - flags
```

## dts/bindings/i2c/espressif,esp32c-i2c.yaml
```yaml
# Copyright (c) 2019 Mohamed ElShahawi (ExtremeGTX@hotmail.com)
# SPDX-License-Identifier: Apache-2.0

description: ESP32C I2C

compatible: "espressif,esp32c-i2c"

include: i2c-controller.yaml

properties:
    reg:
      required: true

    interrupts:
      required: false

    sda-pin:
      type: int
      description: SDA pin
      required: true

    scl-pin:
      type: int
      description: SCL pin
      required: true
```

## dts/bindings/pinctrl/espressif,esp32c-pinmux.yaml
```yaml
# Copyright (c) 2019 Mohamed ElShahawi
# SPDX-License-Identifier: Apache-2.0

description: ESP32C PINMUX

compatible: "espressif,esp32c-pinmux"

include: base.yaml

properties:
    reg:
      required: true
```

## dts/bindings/watchdog/espressif,esp32c-watchdog.yaml
```yaml
# Copyright (c) 2019, Mohamed ElShahawi
# SPDX-License-Identifier: Apache-2.0

description: |
    ESP32C watchdog. ESP32C contains 3x Watchdog timers, 2x Main System Watchdog
    Timer (MWDT), 1x RTC Watchdog Timer (RWDT). RWDT is not supported yet.

compatible: "espressif,esp32c-watchdog"

include: base.yaml

properties:
    reg:
      required: true

    label:
      required: true

    interrupts:
      required: false
```

## soc/xtensa/esp32c/Kconfig.defconfig
```kconfig
# ESP32 board configuration

# Copyright (c) 2020 Espressif Corporation
# SPDX-License-Identifier: Apache-2.0

if SOC_ESP32C

config SOC
	default "esp32c"

config IRQ_OFFLOAD_INTNUM
	default 7

config MP_NUM_CPUS
	default 2

endif
```

## soc/xtensa/esp32c/Kconfig.soc
```kconfig
# Copyright (c) 2017 Intel Corporation
# SPDX-License-Identifier: Apache-2.0

config SOC_ESP32C
	bool "ESP32C"
	select XTENSA
```

## subsys/bluetooth/esp_bluetooth/hci/Kconfig
```kconfig
# Bluetooth common configuration options

# Copyright (c) 2017 Nordic Semiconductor ASA
# Copyright (c) 2016 Intel Corporation
# SPDX-License-Identifier: Apache-2.0
config ESP32_VHCI_CONTROLLER
	bool "Use esp32 vhci controller"
	help
	  This option allows to run esp32 blutooth controller.
```
